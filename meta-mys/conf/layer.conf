## meta-mys/conf/layer.conf
```bitbake
# We have a conf and classes directory, add to BBPATH
BBPATH .= ":${LAYERDIR}"

# We have a packages directory, add to BBFILES
BBFILES += "${LAYERDIR}/recipes-*/*/*.bb \
            ${LAYERDIR}/recipes-*/*/*.bbappend"

BBFILE_COLLECTIONS += "mys"
BBFILE_PATTERN_mys := "^${LAYERDIR}/"
BBFILE_PRIORITY_mys = "7"

LAYERSERIES_COMPAT_mys = "honister"
```

## meta-mys/conf/machine/mys-6ulx.conf
```bitbake
require conf/machine/include/arm/armv7a/tune-cortexa7.inc

MACHINE_FEATURES += "emmc ext2 serial"
MACHINE_EXTRA_RRECOMMENDS += ""

UBOOT_MACHINE = "myir_mys_6ulx_config"
UBOOT_LOADADDRESS = "0x82000000"
UBOOT_ENTRYPOINT = "0x82000000"
UBOOT_ENV = "boot"
UBOOT_ENV_SRC_SUFFIX = "sh"
UBOOT_ENV_SUFFIX = "sh"

PREFERRED_PROVIDER_virtual/kernel = "linux-yocto"
KERNEL_DEVICETREE = "imx6ull-myir-mys-6ulx-eval.dtb"
KERNEL_CLASSES = "kernel-fitimage"
KERNEL_IMAGETYPE = "fitImage"
INITRAMFS_IMAGE = "mys-initramfs"
```
